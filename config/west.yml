## config/west.yml
```yaml
manifest:
  remotes:
    - name: zmkfirmware
      url-base: https://github.com/zmkfirmware
    - name: hitsmaxft
      url-base: https://github.com/hitsmaxft
    - name: englmaxi
      url-base: https://github.com/englmaxi
    - name: urob
      url-base: https://github.com/urob
    - name: janpfischer
      url-base: https://github.com/janpfischer
    - name: yoshimaru46-fork
      url-base: https://github.com/yoshimaru46
    - name: cormoran
      url-base: https://github.com/cormoran
    - name: zzeneg
      url-base: https://github.com/zzeneg
  projects:
    - name: zmk
      remote: zmkfirmware
      revision: main
      clone-depth: 1
      import:
        file: app/west.yml
    - name: zmk-helpers
      remote: urob
      revision: main
      clone-depth: 1
    #- name: zmk-rgbled-widget
    #  remote: hitsmaxft
    #  revision: main
    #  clone-depth: 1
    - name: zmk-dongle-display
      remote: englmaxi
      revision: main
      clone-depth: 1
    - name: zmk-dongle-screen
      remote: yoshimaru46-fork
      revision: add-agent-status-widget   # janpfischer/upgrade-4.1 (ZMK main/Zephyr4用) + 押下キー表示・エージェント状態ウィジェット
      clone-depth: 1
    # herdr のエージェント状態を Mac から受け取る Raw HID(受信側は zmk-dongle-screen の agent ウィジェット)
    - name: zmk-raw-hid
      remote: zzeneg
      revision: main
      clone-depth: 1
    # DYA Studio extensions. ZMK Studio remains enabled as the shared RPC transport.
    - name: zmk-module-ble-management
      remote: cormoran
      revision: main
      clone-depth: 1
    - name: zmk-module-battery-history
      remote: cormoran
      revision: main
      clone-depth: 1
    - name: zmk-module-settings-rpc
      remote: cormoran
      revision: main
      clone-depth: 1
    - name: zmk-module-runtime-input-processor
      remote: cormoran
      revision: main
      clone-depth: 1
  self:
    path: config
```
